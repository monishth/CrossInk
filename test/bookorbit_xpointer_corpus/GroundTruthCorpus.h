#pragma once

#include <cstdlib>
#include <fstream>
#include <string>
#include <vector>

// Ground truth for crengine xpointers, generated by driving the KOReader
// emulator (generate_ground_truth.sh) and committed as CSV so CI never needs
// the emulator. Header-only so several test targets can share it.
namespace corpus {

struct Row {
  int page = 0;
  std::string xpointer;
};

struct Fixture {
  std::string epub;
  int domVersion = 0;
  int domVersionWithNormalizedXPointers = 0;
  std::vector<Row> rows;
};

// crengine's two DOM versions of interest. Below kNormalizedDomVersion the
// emitter omits [1] indices; at or above it every step is indexed.
inline constexpr int kOldestDomVersion = 20171225;
inline constexpr int kNormalizedDomVersion = 20200223;
inline constexpr int kLatestDomVersion = 20260812;

// Every EPUB in test/epubs/, all of which the generator handles.
inline const std::vector<std::string>& epubNames() {
  static const std::vector<std::string> names = {
      "font-prewarm-benchmark",
      "test_br_section_break",
      "test_display_none",
      "test_emoji_ranges",
      "test_force_paragraph_indents",
      "test_jpeg_images",
      "test_kerning_ligature",
      "test_mixed_images",
      "test_png_images",
      "test_reader_rendering_matrix",
      "test_supsub",
      "test_synthetic_unicode_glyphs",
      "test_tables",
  };
  return names;
}

inline std::string fixtureDir() { return std::string(CORPUS_FIXTURE_DIR); }

inline std::string fixturePath(const std::string& epub, const int domVersion) {
  return fixtureDir() + "/" + epub + "_dom" + std::to_string(domVersion) + ".csv";
}

inline std::vector<std::string> fixturePaths(const int domVersion) {
  std::vector<std::string> paths;
  paths.reserve(epubNames().size());
  for (const auto& name : epubNames()) {
    paths.push_back(fixturePath(name, domVersion));
  }
  return paths;
}

// The spine item behind DocFragment[N], extracted from the EPUB zip by the
// generator wrapper. docFragment is 1-based, as in the xpointer.
inline std::string spinePath(const std::string& epub, const int docFragment) {
  return fixtureDir() + "/" + epub + "_frag" + std::to_string(docFragment) + ".xhtml";
}

inline std::string readFile(const std::string& path) {
  std::ifstream stream(path, std::ios::binary);
  if (!stream) return {};
  return std::string((std::istreambuf_iterator<char>(stream)), std::istreambuf_iterator<char>());
}

inline bool loadFixture(const std::string& path, Fixture& out) {
  out = Fixture{};
  std::ifstream stream(path);
  if (!stream) return false;

  std::string line;
  while (std::getline(stream, line)) {
    if (!line.empty() && line.back() == '\r') line.pop_back();
    if (line.empty()) continue;

    if (line[0] == '#') {
      const auto eq = line.find('=');
      if (eq == std::string::npos) continue;
      const std::string key = line.substr(2, eq - 2);
      const std::string value = line.substr(eq + 1);
      if (key == "epub")
        out.epub = value;
      else if (key == "dom_version")
        out.domVersion = std::atoi(value.c_str());
      else if (key == "dom_version_with_normalized_xpointers")
        out.domVersionWithNormalizedXPointers = std::atoi(value.c_str());
      continue;
    }
    if (line.rfind("page,", 0) == 0) continue;  // column header

    const auto comma = line.find(',');
    if (comma == std::string::npos) return false;
    Row row;
    row.page = std::atoi(line.substr(0, comma).c_str());
    row.xpointer = line.substr(comma + 1);
    if (row.page <= 0 || row.xpointer.empty()) return false;
    out.rows.push_back(row);
  }
  return !out.rows.empty();
}

// Verbatim from real KOReader sidecars on the development machine, kept
// alongside the generated corpus as an independent regression case:
//   grep -h last_xpointer /home/monish/repos/imprint-dev-books/*.sdr/metadata.epub.lua
struct SidecarEntry {
  const char* raw;
  const char* canonical;
  const char* provenance;
};

inline constexpr SidecarEntry kSidecarEntries[] = {
    {"/body[1]/DocFragment[1]/body[1]/div[1]/svg[1].0", "/body[1]/DocFragment[1]/body[1]/div[1]/svg[1].0",
     "Sidecar: Japanese Gothic - Kylie Lee Baker (a70862e0e4138fad5f93ca2bc467bb03)"},
    {"/body[1]/DocFragment[1]/body[1]/div[1]/svg[1].0", "/body[1]/DocFragment[1]/body[1]/div[1]/svg[1].0",
     "Sidecar: We Solve Murders - Richard Osman (d18e399f0f79f24d68a8f70b76d59914)"},
};

inline constexpr size_t kSidecarEntryCount = sizeof(kSidecarEntries) / sizeof(kSidecarEntries[0]);

}  // namespace corpus
